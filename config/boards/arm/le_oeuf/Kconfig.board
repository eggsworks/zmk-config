## config/boards/eggsworks/le_oeuf/Kconfig.defconfig
```kconfig
if BOARD_LE_OEUF

config ZMK_KEYBOARD_NAME
    default "L'oeuf"

if USB_DEVICE_STACK
    config USB_NRFX
        default y
endif

config BT_CTLR
    default BT

config ZMK_SLEEP
    default y

endif
```

## config/boards/shields/egg58bt/Kconfig.defconfig
```kconfig
if SHIELD_EGG58BT_LEFT

config ZMK_KEYBOARD_NAME
    default "egg58"

config ZMK_SPLIT_ROLE_CENTRAL
    default y

endif

if SHIELD_EGG58BT_LEFT || SHIELD_EGG58BT_RIGHT

config ZMK_SPLIT
    default y

endif
```

## config/boards/shields/egg58bt/Kconfig.shield
```kconfig
config SHIELD_EGG58BT_LEFT
    def_bool $(shields_list_contains,egg58bt_left)

config SHIELD_EGG58BT_RIGHT
    def_bool $(shields_list_contains,egg58bt_right)
```

## config/boards/shields/le_oeuf/Kconfig.defconfig
```kconfig
if SHIELD_LE_OEUF

config ZMK_KEYBOARD_NAME
    default "Le Oeuf"

config SPI
    default y

endif
```

## config/boards/shields/solanum/Kconfig.defconfig
```kconfig
if SHIELD_SOLANUM_LEFT

config ZMK_KEYBOARD_NAME
    default "Solanum"

config ZMK_SPLIT_ROLE_CENTRAL
    default y

endif

if SHIELD_SOLANUM_LEFT || SHIELD_SOLANUM_RIGHT

config ZMK_SPLIT
    default y

endif
```

## config/boards/shields/solanum/Kconfig.shield
```kconfig
config SHIELD_SOLANUM_LEFT
    def_bool $(shields_list_contains,solanum_left)

config SHIELD_SOLANUM_RIGHT
    def_bool $(shields_list_contains,solanum_right)
```
